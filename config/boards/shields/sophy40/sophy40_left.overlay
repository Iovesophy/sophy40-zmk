/*
 * Copyright (c) 2020 The ZMK Contributors
 *
 * SPDX-License-Identifier: MIT
 */

#include "sophy40.dtsi"

&xiao_i2c {
    status = "disabled";
};

&kscan0 {
    col-gpios 
        = <&xiao_d 10 GPIO_ACTIVE_HIGH>  // Col0: D10/P1.15
        , <&xiao_d 9 GPIO_ACTIVE_HIGH>   // Col1: D9/P1.14
        , <&xiao_d 8 GPIO_ACTIVE_HIGH>   // Col2: D8/P1.13
        , <&xiao_d 7 GPIO_ACTIVE_HIGH>   // Col3: D7/P1.12
        , <&xiao_d 0 GPIO_ACTIVE_HIGH>   // Col4: D0/P0.02
        , <&xiao_d 1 GPIO_ACTIVE_HIGH>   // Col5: D1/P0.03
        ;
};
