/*
 * Copyright (c) 2020 The ZMK Contributors
 *
 * SPDX-License-Identifier: MIT
 */

#include "sophy40.dtsi"

&xiao_i2c {
    status = "disabled";
};

&default_transform {
    col-offset = <6>;
};

&kscan0 {
    col-gpios 
        = <&gpio1 15 (GPIO_ACTIVE_LOW | GPIO_PULL_UP)>
        , <&gpio1 14 (GPIO_ACTIVE_LOW | GPIO_PULL_UP)>
        , <&gpio1 13 (GPIO_ACTIVE_LOW | GPIO_PULL_UP)>
        , <&gpio1 12 (GPIO_ACTIVE_LOW | GPIO_PULL_UP)>
        , <&gpio0 2  (GPIO_ACTIVE_LOW | GPIO_PULL_UP)>
        , <&gpio0 3  (GPIO_ACTIVE_LOW | GPIO_PULL_UP)>
        ;
};
