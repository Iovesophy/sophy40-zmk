## config/boards/shields/sophy40/Kconfig.defconfig
```kconfig
if SHIELD_SOPHY40_LEFT

config ZMK_KEYBOARD_NAME
    default "Sophy40"

config ZMK_SPLIT_ROLE_CENTRAL
    default y

endif

if SHIELD_SOPHY40_LEFT || SHIELD_SOPHY40_RIGHT

config ZMK_SPLIT
    default y

endif
```

## config/boards/shields/sophy40/Kconfig.shield
```kconfig
config SHIELD_SOPHY40_LEFT
    def_bool $(shields_list_contains,sophy40_left)

config SHIELD_SOPHY40_RIGHT
    def_bool $(shields_list_contains,sophy40_right)
```

## config/boards/shields/sophy40_test/Kconfig.defconfig
```kconfig
if SHIELD_SOPHY40_TEST

config ZMK_KEYBOARD_NAME
    default "Sophy40 Test"

endif
```
